## config/west.yml
```yaml
manifest:
  remotes:
    - name: zmkfirmware
      url-base: https://github.com/zmkfirmware
    - name: crystalplanet
      url-base: https://github.com/crystalplanet
  projects:
    - name: zmk
      remote: zmkfirmware
      revision: main
      import: app/west.yml
    - name: zmk-rgb-fx
      remote: crystalplanet
      revision: main
  self:
    path: config
```
